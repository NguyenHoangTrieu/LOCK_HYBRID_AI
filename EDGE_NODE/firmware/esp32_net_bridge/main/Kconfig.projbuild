## EDGE_NODE/firmware/esp32_net_bridge/main/Kconfig.projbuild
```kconfig
menu "LOCK_HYBRID_AI Edge Node Bridge"

    config LOCK_HYBRID_WIFI_PROV_SERVICE_NAME
        string "WiFi setup SoftAP SSID"
        default "LOCK_HYBRID_SETUP"
        help
            SSID the device broadcasts while unprovisioned (or after a
            BOOT-button reset). It's an open AP - join it with any phone
            or laptop and a WiFi-setup page should pop up automatically
            (captive portal, see wifi_captive_portal.c); if it doesn't,
            open http://192.168.4.1 manually. Enter the site's real WiFi
            SSID/password there - esp_wifi stores them to NVS itself, no
            WiFi SSID/password is compiled into this firmware.
            Anyone in range of this AP during setup can set the device's
            WiFi (there's no PoP/password gate on the portal itself,
            matching how captive portals normally work) - fine for a
            physically-controlled install, keep the setup window short
            otherwise.

    config LOCK_HYBRID_WIFI_SSID
        string "WiFi SSID to connect to on first boot (optional)"
        default ""
        help
            Leave empty (default) to keep the captive-portal setup flow
            above - the device boots into the SoftAP and waits for
            someone to submit the real WiFi via a browser. Fill this in
            (and the password below) to skip the portal entirely: on the
            first unprovisioned boot the device connects straight to
            this SSID instead, no manual setup step. Either way, once
            connected the credentials are what esp_wifi persists to its
            own NVS - a later BOOT-button factory reset re-enters the
            portal regardless of what was compiled in here.

    config LOCK_HYBRID_WIFI_PASSWORD
        string "WiFi password for the SSID above"
        default ""

    config LOCK_HYBRID_BACKEND_BASE_URL
        string "Cloud Backend base URL"
        default "http://192.168.1.100:8000"
        help
            e.g. http://<server-ip>:8000 for the CLOUD_SERVER dev
            instance, or an https:// URL once a reverse proxy with a real
            certificate is in front of it (CI-1 requires encryption in
            transit - this dev default does not provide that).

    config LOCK_HYBRID_DEVICE_API_KEY
        string "Device API key"
        default ""
        help
            The raw key shown once by POST /admin/api/devices in the
            admin web app (CLOUD_SERVER) when this device was registered.
            Cannot be recovered from the server afterwards - re-register
            the device if it's lost.

    config LOCK_HYBRID_BACKEND_AUTO_DISCOVER
        bool "Auto-discover backend IP via UDP broadcast"
        default y
        help
            Before falling back to the URL below (or its NVS override),
            broadcast a UDP discovery request on
            LOCK_HYBRID_BACKEND_DISCOVERY_PORT and use whichever host
            replies - see backend_discovery.c. Point at
            CLOUD_SERVER/deploy/discovery_responder.py running on the
            backend host. Lets the device find the server on its current
            DHCP-assigned IP without re-provisioning every time that IP
            changes; the URL below (or NVS override) is still used as a
            fallback whenever no reply arrives in time. mDNS was tried
            first and ruled out - see backend_discovery.h for why.

    config LOCK_HYBRID_BACKEND_DISCOVERY_PORT
        int "Backend discovery UDP port"
        default 47623
        depends on LOCK_HYBRID_BACKEND_AUTO_DISCOVER
        help
            Must match discovery_responder.py's own port on the backend
            host (its --port flag / DISCOVERY_PORT default).

    config LOCK_HYBRID_BACKEND_TIMEOUT_MS
        int "Backend HTTP request timeout (ms)"
        default 8000
        help
            Generous relative to PR-1's 2s device-to-unlock target - the
            MCXN947 side's own NET_RequestDecision() timeout is what
            actually governs the user-facing latency budget; this is a
            backstop so a hung TCP connection doesn't wedge the worker
            task forever.

    config LOCK_HYBRID_BACKEND_SKIP_TLS_VERIFY
        bool "Skip TLS certificate verification (dev only)"
        default n
        help
            Only for testing against a self-signed cert during
            development. Leave OFF for anything resembling a real
            deployment - CI-1 means "actually encrypted and verified",
            not just "the bytes happen to be TLS".

endmenu
```
